## platforms/stamp-p4/firmware/main/Kconfig.projbuild
```kconfig
menu "MindIOU Stamp-P4"

    config MINDIOU_DISPLAY_MOCK
        bool "Mock 显示后端（串口日志）"
        default y

    config MINDIOU_DISPLAY_MIPI_DSI
        bool "真实 MIPI DSI 显示后端（需完整资料，暂勿启用）"
        default n

    config MINDIOU_WIFI_SSID
        string "Wi-Fi SSID"
        default ""

    config MINDIOU_WIFI_PASSWORD
        string "Wi-Fi 密码"
        default ""

    config MINDIOU_BRIDGE_URI
        string "Bridge WebSocket URI"
        default "ws://192.168.1.100:7020"

    config MINDIOU_DEVICE_ID
        string "设备 ID"
        default "stamp-p4-001"

    config MINDIOU_RECONNECT_MAX_MS
        int "重连最大退避（ms）"
        default 30000

    config MINDIOU_PING_INTERVAL_MS
        int "心跳间隔（ms）"
        default 15000

endmenu
```

## platforms/stamp-p4/firmware/sdkconfig.defaults
```kconfig
# ESP32-P4 目标
CONFIG_IDF_TARGET="esp32p4"

# 显示后端编译开关：第一版仅 Mock（串口日志），真实 MIPI DSI 暂不启用。
# 禁止在未获得完整 Pin 定义/时序前打开 MIPI_DSI。
CONFIG_MINDIOU_DISPLAY_MOCK=y
CONFIG_MINDIOU_DISPLAY_MIPI_DSI=n

# Wi-Fi（Stamp AddOn C6；凭据用 menuconfig 或 Kconfig 默认值覆盖）
CONFIG_MINDIOU_WIFI_SSID=""
CONFIG_MINDIOU_WIFI_PASSWORD=""

# Bridge 地址（手机/服务端 WebSocket）
CONFIG_MINDIOU_BRIDGE_URI="ws://192.168.1.100:7020"
CONFIG_MINDIOU_DEVICE_ID="stamp-p4-001"

# 重连：指数退避，最大 30s
CONFIG_MINDIOU_RECONNECT_MAX_MS=30000
CONFIG_MINDIOU_PING_INTERVAL_MS=15000
```
